## config/Kconfig
```kconfig
mainmenu "Smart Modular BioReactor firmware configuration"

choice
    prompt "Module type"
    help
        Type of module for which will be firmware build
    config CONTROL_MODULE
        bool "control_module"
    config SENSOR_MODULE
        bool "sensor_module"
endchoice

config MODULE_TYPE
    string
    default "control_module" if CONTROL_MODULE
    default "sensor_module" if SENSOR_MODULE

config CANBUS_SPEED
    int "CAN bus speed"
    default 500000

choice
    prompt "Bootloader offset"
    config BOOTLOADER_OFFSET_16K
        bool "16KiB bootloader"
    config BOOTLOADER_OFFSET_0K
        bool "No bootloader"
endchoice

config BOOTLOADER
    bool
    default n if BOOTLOADER_OFFSET_0K
    default y

config BOOTLOADER_OFFSET
    hex
    default 0x10004000 if BOOTLOADER_OFFSET_16K
    default 0x10000100

comment "Development configurations"

config LOGGER
    bool "Logger output"
    default y
    help
        Enable debug output to serial line (baudrate: 961200)

choice
    prompt "Logger level"
    depends on LOGGER
    default LOGGER_LEVEL_NOTICE
    help
        Severity of log messages which will be printed, lower are discarded
    config LOGGER_LEVEL_TRACE
        bool "Trace"
    config LOGGER_LEVEL_DEBUG
        bool "Debug"
    config LOGGER_LEVEL_NOTICE
        bool "Notice"
    config LOGGER_LEVEL_WARNING
        bool "Warning"
    config LOGGER_LEVEL_ERROR
        bool "Error"
    config LOGGER_LEVEL_CRITICAL
        bool "Critical"
endchoice

config LOGGER_LEVEL
    int
    default 0 if LOGGER_LEVEL_TRACE
    default 1 if LOGGER_LEVEL_DEBUG
    default 2 if LOGGER_LEVEL_NOTICE
    default 3 if LOGGER_LEVEL_WARNING
    default 4 if LOGGER_LEVEL_ERROR
    default 5 if LOGGER_LEVEL_CRITICAL
    default 2

config WATCHDOG
    bool "Enable watchdog"
    default y
    help
        Enable watchdog timer to reset the system when it hangs

config TEST_THREAD
    bool "Test thread execution"
    default n
    help
        Enable testing thread for development experiments
```
